## firmware/main/Kconfig.projbuild
```kconfig
menu "Hermes Desk Configuration"

    config WIFI_SSID
        string "WiFi SSID"
        default "motowireless50"
        help
            SSID of the WiFi network the Tab5 should join.

    config WIFI_PASS
        string "WiFi Password"
        default "ownyourshitasshole"
        help
            WPA2 PSK for the WiFi network.

    config BRIDGE_HOST
        string "Bridge Host IP"
        default "10.0.2.64"
        help
            IP address of the host running the Hermes Desk bridge service.

    config BRIDGE_PORT
        int "Bridge Port"
        default 8765
        help
            WebSocket port of the bridge service.

    config BRIDGE_TOKEN
        string "Bridge Auth Token"
        default ""
        help
            Auth token for the bridge WebSocket endpoint. Leave empty if
            the bridge is running without auth (LAN-only deployment).

endmenu
```

## firmware/sdkconfig.defaults
```kconfig
################################################################################
# Hermes Desk — M5Stack Tab5 (ESP32-P4) sdkconfig.defaults
#
# Apply with: idf.py set-target esp32p4 && idf.py build
# (sdkconfig.defaults is auto-merged by the build system.)
#
# This file encodes the non-obvious hardware facts for the Tab5, the two big
# ones being:
#
#   1. The ESP32-P4 has NO radio. WiFi/BLE live on an ESP32-C6 co-processor
#      reached over SDIO via the esp_hosted transport. The Tab5 wires SDIO to
#      non-default GPIOs (NOT the P4-Function-EV-Board defaults), and the C6
#      is powered through a PI4IOE5V6408 IO-expander pin that the BSP turns on.
#
#   2. Audio is 16 kHz / 16-bit / mono PCM (per docs/PROTOCOL.md). The codec
#      stack (ES8388 DAC + ES7210 mic ADC) is configured for that rate.
################################################################################

# --- Target / platform -------------------------------------------------------
CONFIG_IDF_TARGET="esp32p4"
CONFIG_IDF_TARGET_ESP32P4=y

# Tab5 uses ESP32-P4 revision v1.x (eco2 silicon). Allow any rev so the
# bootloader doesn't reject the chip. Default is v3.01 which causes a
# "requires chip revision in range [v3.1 - v3.99]" flash error on v1.3 silicon.
# ESP32P4_SELECTS_REV_LESS_V3 is the Kconfig gate for <3.0 support — must be
# set before ESP32P4_REV_MIN_0 becomes selectable.
CONFIG_ESP32P4_SELECTS_REV_LESS_V3=y
CONFIG_ESP32P4_REV_MIN_0=y

# The Tab5 ships 16 MB flash. Match partitions.csv.
CONFIG_ESPTOOLPY_FLASHSIZE_16MB=y
CONFIG_ESPTOOLPY_FLASHSIZE="16MB"
CONFIG_PARTITION_TABLE_CUSTOM=y
CONFIG_PARTITION_TABLE_CUSTOM_FILENAME="partitions.csv"
CONFIG_PARTITION_TABLE_FILENAME="partitions.csv"

# Enable PSRAM (32 MB on the Tab5) — LVGL framebuffers + audio buffers want it.
CONFIG_SPIRAM=y
CONFIG_SPIRAM_MODE_HEX=y
CONFIG_SPIRAM_SPEED_200M=y
# Let malloc use PSRAM for large allocations; helpful for the display buffers.
CONFIG_SPIRAM_TRY_ALLOCATE_WIFI_LARGEBLOCK=y

# --- ESP32-C6 co-processor (WiFi over SDIO via esp_hosted) ------------------
# Per M5Stack Tab5 schematic + esp-hosted-mcu issue #127. These are the SDIO
# GPIOs the Tab5 actually uses — NOT the P4-Function-EV-Board defaults. Getting
# these wrong manifests as `sdmmc_init_ocr: send_op_cond returned 0x107` and a
# zero MAC at runtime.
CONFIG_SLAVE_IDF_TARGET_ESP32C6=y
CONFIG_ESP_HOSTED_CP_TARGET_ESP32C6=y

# Do NOT use the dev-board GPIO preset; we supply the Tab5 pins explicitly.
CONFIG_ESP_HOSTED_P4_DEV_BOARD_NONE=y
CONFIG_ESP_HOSTED_DEV_BOARD_GPIO_CONFIG=n

# Hosted SDIO pin map (Tab5):
# The Kconfig uses RANGE_MIN as the actual GPIO value when no dev board is selected.
# Tab5 pins per M5Stack schematic + esp-hosted-mcu issue #127:
#   CMD=13, CLK=12, D0=11, D1=10, D2=9, D3=8, RESET=15
CONFIG_ESP_HOSTED_SDIO_CMD_GPIO_RANGE_MIN=13
CONFIG_ESP_HOSTED_SDIO_CMD_GPIO_RANGE_MAX=13
CONFIG_ESP_HOSTED_SDIO_CLK_GPIO_RANGE_MIN=12
CONFIG_ESP_HOSTED_SDIO_CLK_GPIO_RANGE_MAX=12
CONFIG_ESP_HOSTED_SDIO_D0_GPIO_RANGE_MIN=11
CONFIG_ESP_HOSTED_SDIO_D0_GPIO_RANGE_MAX=11
CONFIG_ESP_HOSTED_SDIO_D1_GPIO_RANGE_MIN=10
CONFIG_ESP_HOSTED_SDIO_D1_GPIO_RANGE_MAX=10
CONFIG_ESP_HOSTED_SDIO_D2_GPIO_RANGE_MIN=9
CONFIG_ESP_HOSTED_SDIO_D2_GPIO_RANGE_MAX=9
CONFIG_ESP_HOSTED_SDIO_D3_GPIO_RANGE_MIN=8
CONFIG_ESP_HOSTED_SDIO_D3_GPIO_RANGE_MAX=8
CONFIG_ESP_HOSTED_SDIO_RESET_SLAVE_GPIO_MIN=15
CONFIG_ESP_HOSTED_SDIO_RESET_SLAVE_GPIO_MAX=15
# Actual GPIO pin assignments (override the dev-board defaults):
CONFIG_ESP_HOSTED_HOST_SDIO_PIN_CMD=13
CONFIG_ESP_HOSTED_HOST_SDIO_PIN_CLK=12
CONFIG_ESP_HOSTED_HOST_SDIO_PIN_D0=11
CONFIG_ESP_HOSTED_HOST_SDIO_PIN_D1=10
CONFIG_ESP_HOSTED_HOST_SDIO_PIN_D2=9
CONFIG_ESP_HOSTED_HOST_SDIO_PIN_D3=8
CONFIG_ESP_HOSTED_HOST_RESET_GPIO=15

# Reset polarity: the Tab5's C6 reset line is active-HIGH. The esp-hosted
# default assumes active-low, which leaves the C6 held in reset and the link
# never comes up. (See esp-hosted-mcu issue #127, comment re: sdio_drv.c.)
CONFIG_ESP_HOSTED_SDIO_RESET_ACTIVE_HIGH=y

# Reset strategy: try card init WITHOUT resetting first, only reset if it fails.
# The ALWAYS strategy has a bug on the Tab5 where the C6 is left held in reset
# (esp-hosted-mcu issue #127, May 2026 comment).
CONFIG_ESP_HOSTED_HOST_CP_RESET_STRATEGY_ONLY_IF_NECESSARY=y

# Throughput / buffering tuned for streaming PCM audio over WiFi.
CONFIG_WIFI_RMT_STATIC_RX_BUFFER_NUM=16
CONFIG_WIFI_RMT_DYNAMIC_RX_BUFFER_NUM=64
CONFIG_WIFI_RMT_DYNAMIC_TX_BUFFER_NUM=64
CONFIG_WIFI_RMT_AMPDU_TX_ENABLED=y
CONFIG_WIFI_RMT_TX_BA_WIN=32
CONFIG_WIFI_RMT_AMPDU_RX_ENABLED=y
CONFIG_WIFI_RMT_RX_BA_WIN=32

# LWIP — bigger TCP windows for low-latency audio over the WS link.
CONFIG_LWIP_TCP_SND_BUF_DEFAULT=65534
CONFIG_LWIP_TCP_WND_DEFAULT=65534
CONFIG_LWIP_TCP_RECVMBOX_SIZE=64
CONFIG_LWIP_UDP_RECVMBOX_SIZE=64
CONFIG_LWIP_TCPIP_RECVMBOX_SIZE=64
CONFIG_LWIP_TCP_SACK_OUT=y

# --- WebSocket client --------------------------------------------------------
CONFIG_ESP_WS_CLIENT_ENABLE=y
# Dynamic task/buffer sizing — we carry a 20 ms PCM frame (640 B) per send.
CONFIG_ESP_WS_CLIENT_TASK_STACK=8192

# --- LVGL --------------------------------------------------------------------
# Use the ESP-BSP LVGL port. 1280x720 RGB framebuffer lives in PSRAM.
CONFIG_BSP_DISPLAY_LVGL=y
CONFIG_LV_COLOR_DEPTH_16=y
CONFIG_LV_COLOR_16_SWAP=y
# Hand the draw buffers + tick to esp_lvgl_port; keep LVGL mem in PSRAM.
CONFIG_LV_USE_PERF_MONITOR=y
CONFIG_LV_MEM_CUSTOM=y
# Montserrat fonts used by the display component (14=body, 20=boot, 24=status,
# 28=transcript, 32=reply, 36=card title, 48=card icon).
CONFIG_LV_FONT_MONTSERRAT_14=y
CONFIG_LV_FONT_MONTSERRAT_20=y
CONFIG_LV_FONT_MONTSERRAT_24=y
CONFIG_LV_FONT_MONTSERRAT_28=y
CONFIG_LV_FONT_MONTSERRAT_32=y
CONFIG_LV_FONT_MONTSERRAT_36=y
CONFIG_LV_FONT_MONTSERRAT_48=y

# --- Audio -------------------------------------------------------------------
# ES8388 (speaker) + ES7210 (dual mic) via the BSP codec stack. We run the
# link at 16 kHz to match the bridge wire format (no on-device resample).
CONFIG_BSP_I2S_NUM=0

# --- Logging -----------------------------------------------------------------
CONFIG_LOG_DEFAULT_LEVEL_INFO=y
CONFIG_LOG_DEFAULT_LEVEL=3

# --- FreeRTOS ---------------------------------------------------------------
# The audio capture task and the WS TX path both want decent stacks.
CONFIG_FREERTOS_HZ=1000
```
